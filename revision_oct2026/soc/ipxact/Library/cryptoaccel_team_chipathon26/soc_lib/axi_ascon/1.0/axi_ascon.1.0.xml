# axi_ascon: IP-XACT component
VLNV cryptoaccel_team_chipathon26:soc_lib:axi_ascon:1.0
ASCON-AEAD128 AXI4-Lite slave (pd_closure/base/rtl/axi_ascon.v, unmodified)

## Bus interfaces (logical=physical port)
S_AXI: slave cryptoaccel_team_chipathon26:soc_lib:axi4lite:1.0, memory map ascon_regs
  AWADDR=S_AXI_AWADDR, AWPROT=S_AXI_AWPROT, AWVALID=S_AXI_AWVALID, AWREADY=S_AXI_AWREADY, WDATA=S_AXI_WDATA, WSTRB=S_AXI_WSTRB, WVALID=S_AXI_WVALID, WREADY=S_AXI_WREADY, BRESP=S_AXI_BRESP, BVALID=S_AXI_BVALID, BREADY=S_AXI_BREADY, ARADDR=S_AXI_ARADDR, ARPROT=S_AXI_ARPROT, ARVALID=S_AXI_ARVALID, ARREADY=S_AXI_ARREADY, RDATA=S_AXI_RDATA, RRESP=S_AXI_RRESP, RVALID=S_AXI_RVALID, RREADY=S_AXI_RREADY

## Ports
in S_AXI_ACLK
in S_AXI_ARESETN
in S_AXI_AWADDR[6:0]
in S_AXI_AWPROT[2:0]
in S_AXI_AWVALID
out S_AXI_AWREADY
in S_AXI_WDATA[31:0]
in S_AXI_WSTRB[3:0]
in S_AXI_WVALID
out S_AXI_WREADY
out S_AXI_BRESP[1:0]
out S_AXI_BVALID
in S_AXI_BREADY
in S_AXI_ARADDR[6:0]
in S_AXI_ARPROT[2:0]
in S_AXI_ARVALID
out S_AXI_ARREADY
out S_AXI_RDATA[31:0]
out S_AXI_RRESP[1:0]
out S_AXI_RVALID
in S_AXI_RREADY

## Address spaces and blocks
ascon_regs.regs: base 0x0, range 0x80, width 32

## Registers
Registers are 32-bit, write-only, no defined reset value unless marked. A register's access mark holds for its fields unless they carry their own. Offsets are from the block's base; lines under a group give offsets from that group; [hi:lo] are bit positions; {n}, {i} and the like mark numbered series; 'fields as' and 'values as' point back to an identical list; <NAME> marks a mode.

## ascon_regs.regs
Base 0x00000000
0x00 KEY0 — key[31:0]
  [31:0] value
{0x0+4i} KEY{i} (i=1..3)
  [31:0] value
{0x10+4i} NONCE{i} (i=0..3)
  [31:0] value
0x20 CTRL — bit0 start, bit1 dec_mode, bit2 ad_empty
  [31:0] value
0x24 STATUS ro — bit0 busy,1 done,2 auth_ok,3 in_ready,4 dout_ready
  [31:0] value
0x28 BLK — bit0 stream(0=AD,1=data), bit1 last, bits[6:2] bytes
  [31:0] value
{0x30+4i} DIN{i} (i=0..2)
  [31:0] value
0x3C DIN3 — write pushes block
  [31:0] value
{0x40+4i} DOUT{i} ro (i=0..2)
  [31:0] value
0x4C DOUT3 ro — read drains block
  [31:0] value
0x50 TAG0 rw — write: expected tag (dec); read: computed tag
  [31:0] value
{0x50+4i} TAG{i} rw (i=1..3)
  [31:0] value
